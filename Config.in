## package/bro/Config.in
```kconfig
comment "Bro needs a uClibc or glibc toolchain w/ wchar, dynamic library"
	depends on !BR2_bfin
	depends on !BR2_USE_WCHAR || BR2_STATIC_LIBS || !(BR2_TOOLCHAIN_USES_UCLIBC || BR2_TOOLCHAIN_USES_GLIBC)

config BR2_PACKAGE_BRO
  bool "Bro"
  depends on BR2_USE_WCHAR
	depends on !BR2_STATIC_LIBS
  depends on BR2_TOOLCHAIN_USES_UCLIBC || BR2_TOOLCHAIN_USES_GLIBC
  select BR2_PACKAGE_LIBPCAP
  select BR2_PACKAGE_BIND
  select BR2_PACKAGE_OPENSSL
  select BR2_PACKAGE_ZLIB
  help
    Bro is a powerful network analysis framework
    see http://www.bro-ids.org/downloads/release/

if BR2_PACKAGE_BRO

  config BR2_PACKAGE_BRO_BROCCOLI
    bool "Broccoli"
    help
      Enable Broccoli communication library for Bro.

  if BR2_PACKAGE_BRO_BROCCOLI
    config BR2_PACKAGE_BRO_BROCCOLI_BINDINGS
      select BR2_PACKAGE_PYTHON3
      bool "Python bindings for Broccoli"
      select BR2_PACKAGE_SWIG
      default y
      help
        Install Python bindings for Broccoli.
    endif

endif
```
